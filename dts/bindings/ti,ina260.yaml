## dts/bindings/ti,ina260.yaml
```yaml
#
# Copyright 2021 The Chromium OS Authors
# Copyright 2021 Grinn
#
# SPDX-License-Identifier: Apache-2.0
#

description: |
    TI INA260 Bidirectional Current and Power Monitor.
    The <zephyr/dt-bindings/sensor/ina260.h> file should be included in the
    DeviceTree and it provides macro that can be used for initializing the
    configuration register.

compatible: "ti,ina260"

include: ti,ina26x-common.yaml

properties:
    mask:
      type: int
      required: false
      default: 0
      # default all alert sources to disabled
      description: Mask register, default matches the power-on reset value

    alert-limit:
      type: int
      required: false
      default: 0
      # default alert limit is 0V
      description: Alert register, default matches the power-on reset value
```

## dts/bindings/ti,ina26x-common.yaml
```yaml
#
# Copyright 2021 Grinn
#
# SPDX-License-Identifier: Apache-2.0
#

include: [sensor-device.yaml, i2c-device.yaml]

properties:
    config:
      type: int
      required: true
      description: |
        Value of the configuration register
        e.g shunt voltage and bus voltage ADC conversion
        times and averaging, operating mode for INA260

    alert-gpios:
      type: phandle-array
      required: false
      description: Alert pin
```

## opito_ina260_i2c/Kconfig
```kconfig
# Copyright 2021 The Chromium OS Authors
#
# SPDX-License-Identifier: Apache-2.0
menu "Opito INA260 Current Sensor"
config INA26X
	bool "INA26X Current and Power Monitor"
	default y
	select I2C
	help
	  Enable driver for INA26X Current and Power Monitor.

if INA26X

config INA260
	bool "INA260"
	default y
	help
	  Enable driver for INA260


config INA260_TRIGGER
	bool "INA260 trigger mode"
	depends on INA260
	help
	  Set to enable trigger mode using gpio interrupt, where
	  interrupts are configured to line ALERT PIN.

endif # INA26X
endmenu
```
